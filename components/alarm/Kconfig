## components/alarm/Kconfig
```kconfig
menu "Alarms"
	config ALARM_TASK_PRIO
		int "Priority of the task"
		default 12

	config ALARM_TASK_CORE
		int "Core of the task"
		default 0

	config ALARM_ITEM_MAX
		int "Maximum alarm items that can be stored"
		default 50
		range 0 65535

	config ALARM_NVS_PART_CUSTOM
		bool "NVS: Use custom partition"
		default n

	config ALARM_NVS_PART_CUSTOM_NAME
		string "NVS: Partition name"
		default "alarms"
		depends on ALARM_NVS_PART_CUSTOM
	
	config ALARM_NVS_NAMESPACE_NAME
		string "NVS: Namespace name"
		default "alarms"
endmenu
```

## components/settings/Kconfig
```kconfig
menu "Settings"

	config SETTINGS_PATH_KEYS
		string "Settings keys path"
		default "res/settings_keys.csv"

	config SETTINGS_PATH_GROUPS
		string "Settings groups path"
		default "res/settings_groups.csv"

	config SETTINGS_PATH_DEFS
		string "Settings groups path"
		default "res/settings_defs.h"

	config SETTINGS_GROUP_INSTANCE_MAX
		range 1 65535
		int "Maximum instances for a multi-instance group"
		default 99

	config SETTINGS_GROUP_NAME_LENGTH_MAX
		int "Maximum length of a group name"
		default 20

	config SETTINGS_KEY_NAME_LENGTH_MAX
		int "Maximum length of a key name"
		default 30
	
	config SETTINGS_BLOCKING
		bool "Block during concurrent calls"
		default y
		help
			Whether two parrallel calls should have the second one block until
			the first one is finished.
			If set, the blocking timeout is defined by SETTINGS_BLOCKING_TIMEOUT_MS

	config SETTINGS_BLOCKING_TIMEOUT_MS
		int "Concurrent blocking timeout in ms"
		default 2
		help
			The maximum amount of time in ms that a function is allowed to block
		depends on SETTINGS_BLOCKING

	choice SETTINGS_IMPL
		prompt "Settings back-end implementation"
        default SETTINGS_IMPL_NVS
			config SETTINGS_IMPL_NVS
				bool "NVS"
	endchoice

	config SETTINGS_IMPL_NVS_PART_CUSTOM
		bool "NVS: Use custom partition"
		default n
		depends on SETTINGS_IMPL_NVS

	config SETTINGS_IMPL_NVS_PART_CUSTOM_NAME
		string "NVS: Partition name"
		default "settings"
		depends on SETTINGS_IMPL_NVS && SETTINGS_IMPL_NVS_PART_CUSTOM

endmenu
```

## components/urp/Kconfig
```kconfig
menu "URP"

	config URP_RECV_BUF_SIZE
		int "UART receiver buffer size"
		default 1024

	config URP_VALUE_TYPE_LENGTH
		int "Number of character in the value type"
		default 3

	config URP_RECV_TASK_PRIO
		int "Priority of the recv task"
		default 12

	config URP_RECV_DATA_SIZE_MAX
		int "Maximum receive data size"
		default 256
		help
			This does not include start and end characters as well as value type and checksum.

	config URP_SEND_BUF_SIZE
		int "UART TX buffer size"
		default 0

endmenu
```

## lib/urp/Kconfig
```kconfig
# Kconfig - URP library options

#
# Copyright (c) 2023 Farès Chati
#
# SPDX -License-Identifier: Apache-2.0
#

menuconfig URP
	bool "UART Readable Protocole"
	default n

if (URP)

# UART receiver buffer size
config URP_RECV_BUF_SIZE
	int "UART receiver buffer size"
	default 1024

# Number of character in the value type
config URP_VALUE_TYPE_LENGTH
	int "Number of character in the value type"
	default 3

# Priority of the recv thread
config URP_RECV_THREAD_PRIO
	int "Priority of the recv thread"
	default 0

# Maximum size of messages to receive.
# This does not include start and end characters as well as value type and checksum.
config URP_RECV_DATA_SIZE_MAX
	int "Maximum receive data size"
	default 256

endif #URP
```

## main/KConfig.projbuild
```kconfig
menu "Lumos"

	config LUMOS_DIMMED_MODE
		bool "Dimmed mode"
		default n

	config LUMOS_UART_BAUD_RATE
		int "UART baud rate"
		default 115200

endmenu
```

## main/Kconfig
```kconfig
menu "Lumos project"
	config LUMOS_COM_CORE_ID
		int "Execution core for communication tasks"
		default 1

	config LUMOS_SPIFFS_MAX_OPENED_FILES
		int "Maximum SPIFFS parrallel opened files"
		default 5

	config LUMOS_SPIFFS_MUTEX_TIMEOUT_MS
		int "SPIFFS read timeout"
		default 50
		help
			Read timeout in case of more than LUMOS_SPIFFS_MAX_OPENED_FILES
			concurrent access of the SPIFFS

	config LUMOS_UART_COM_BAUD_RATE
		int "UART baud rate"
		default 115200

	config LUMOS_LIGHT_DIMMED_MODE
		bool "Dimmed mode"
		default n
endmenu
```
